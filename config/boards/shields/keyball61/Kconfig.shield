## config/boards/shields/keyball61/Kconfig.shield
```kconfig
config SHIELD_KEYBALL61_LEFT
    def_bool $(shields_list_contains,keyball61_left)

config SHIELD_KEYBALL61_RIGHT
    def_bool $(shields_list_contains,keyball61_right)

config SHIELD_KEYBALL61_DAILY_POWER
    def_bool $(shields_list_contains,keyball61_daily_power)
```

## config/boards/shields/keyball61_left_view/Kconfig.shield
```kconfig
# SPDX-License-Identifier: MIT

config SHIELD_KEYBALL61_LEFT_VIEW
    def_bool $(shields_list_contains,keyball61_left_view)
```

## config/boards/shields/keyball61_power_guard/Kconfig.shield
```kconfig
config SHIELD_KEYBALL61_POWER_GUARD
    def_bool $(shields_list_contains,keyball61_power_guard)
```

## config/west.yml
```yaml
manifest:
  remotes:
    - name: zmkfirmware
      url-base: https://github.com/zmkfirmware
    - name: kumamuk-git
      url-base: https://github.com/kumamuk-git
    - name: nameisrtr
      url-base: https://github.com/nameisrtr
  projects:
    - name: zmk
      remote: zmkfirmware
      revision: v0.2
      import: app/west.yml
    - name: zmk-pmw3610-driver
      remote: nameisrtr
      revision: 7ee6d2ff94c6b8a39a741e583d3109cdc6cec675
  self:
    path: config
```
